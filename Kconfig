## Kconfig
```kconfig
source "behavior/Kconfig"
source "runtime/Kconfig"
source "part/Kconfig"
source "fs/Kconfig"
source "users/Kconfig"
source "net/Kconfig"
source "repos/Kconfig"
source "security/Kconfig"
source "pkg/Kconfig"
source "diag/Kconfig"
source "hw/Kconfig"
source "sys/Kconfig"
source "arch/Kconfig"
```

## arch/Kconfig
```kconfig
choice
	prompt "Target architecture"
	default MKQNX_ARCH_X86_64
    help
        Architecture to build for.  For VMWare and VirtualBox, only x86_64 is supported.

config MKQNX_ARCH_X86_64
	bool "x86_64"
config MKQNX_ARCH_AARCH64LE
	bool "aarch64le"
endchoice
```

## behavior/Kconfig
```kconfig
menu "Behavior"

# NOTE: --force is intentionally removed from the UI and always passed by the
# build script to avoid mkqnximage refusing to write into non-empty directories.

config MKQNX_CLEAN
	bool "Clean output directory before building"
	default n
	help
	  Clean output directory prior to building. This can be useful in cases
	  where an image might not have been built correctly due to changes in
	  files that mkqnximage was unaware of, for example following an update
	  to the package containing mkqnximage. Other than taking slightly
	  longer, --clean should always be safe to use and is useful if there
	  is some doubt as to what was built.

config MKQNX_VERBOSE
	bool "Verbose build output"
	default n
	help
	  If yes, output additional information while building images. Omitting
	  the value is equivalent to using --verbose=yes. The option must be
	  respecified each time mkqnximage is run to have an effect.

config MKQNX_ASSUMED_IP
	string "Assumed IP address or 'none'"
	default ""
	help
	  Use the provided IP address rather than trying to resolve it. If set to
	  'none', normal resolution occurs.

config MKQNX_NOPROMPT
	bool "Don't prompt; fail if prompt would be required"
	default n
	help
	  Don't ever prompt for anything and instead fail if a prompt is
	  required. This is not usually wanted unless running in an environment
	  where it is not possible to request information.

endmenu # Behavior
```

## diag/Kconfig
```kconfig
menu "Diagnostics"

config MKQNX_IO_SOCK_DIAG
	bool "Use diagnostic io-sock version"
	default n
    help
        If yes, use the version of io-sock with extra diagnostics (io-sock-diag)

config MKQNX_SANITIZERS
	bool "Load sanitizer libraries on boot"
	default n
    help
        If set to yes, sanitizer libraries will be loaded on the system (libubsan.so,
        libasan.so, etc.).

config MKQNX_QH_CONFIG
	string "slog2 logging configuration"
	default "no"
    help
        mkqnximage will convert the configuration provided in the argument and set
        logging configuration in both command-line and non command-line mode for slog2.

        

endmenu # Diagnostics
```

## fs/Kconfig
```kconfig
menu "File System & Integrity"

config MKQNX_UNION
    bool "Use traditional QNX union FS at /"                      
    default y
	help
	  If yes, use the traditional QNX organisation that has the ifs
	  mounted at /. If no, a union free system is created. With no
	  unions, opens are slightly faster as only a single resource manager
	  has to be queried for any path.

choice
	prompt "Compress /system and make it read-only using QCFS"
	default MKQNX_QCFS_NO
	help
	  If not 'no', the system partition is read-only and uses the QNX
	  Compressed Filesystem driver. 'yes': use the lz4hc algorithm.
	  'lz4hc': use the lz4hc algorithm. 'zstd': use the zstd algorithm.

config MKQNX_QCFS_NO
	bool "no"
config MKQNX_QCFS_YES
	bool "yes (lz4hc)"
config MKQNX_QCFS_LZ4HC
	bool "lz4hc"
config MKQNX_QCFS_ZSTD
	bool "zstd"

endchoice

config MKQNX_QTD
	bool "Make /system read-only by wrapping in a QTD container"
	default n
	help
	  If yes, the system partition is read-only and protected by wrapping
	  in a QTD container. This is a good idea for a released system but
	  may be inconvenient in cases where security is not important.

config MKQNX_QTSAFEFS
	bool "Make /system read-only using qtsafefs"
	default n
	help
	  If yes, the system partition is read-only and uses the QNX trusted
	  filesystem for safety driver (qtsafefsd).

choice
	prompt "/data mount option"
	default MKQNX_SECURE_DATA_NO
	help
	  If no, the default, the /data directory allows executables to be
	  run from it. For a secure system, ideally this should not be
	  allowed or at a minimum suid binaries should be disallowed which
	  the options, noexec and nosuid enable (see mount utility for
	  details).

config MKQNX_SECURE_DATA_NO
	bool "no"
config MKQNX_SECURE_DATA_NOSUID
	bool "nosuid"
config MKQNX_SECURE_DATA_NOEXEC
	bool "noexec"
endchoice

config MKQNX_PATHTRUST
	bool "Enable pathtrust"
	default n
	help
	  If set to yes, the pathtrust feature will be enabled. This causes
	  the setuid/setgid bits of binaries to be ignored unless they are on
	  a trusted file system and requires any process that tries to
	  execute a binary or load a shared object from an untrusted file
	  system have the untrusted_exec ability. It also allows the function
	  fchecktrust to distinguish trusted and untrusted files.
	  
	  By default, only the ifs will be trusted. If the --qtd option is
	  set to yes, the system partition will also be trusted.

choice
	prompt "Zoneinfo Source"
	default MKQNX_ZONEINFO_SRC_NONE
	help
	  Select the source for the zoneinfo (timezone) database.

	config MKQNX_ZONEINFO_SRC_NONE
		bool "None"

	config MKQNX_ZONEINFO_SRC_DEFAULT
		bool "Default (recommended)"

	config MKQNX_ZONEINFO_SRC_CUSTOM
		bool "Custom Path"
endchoice

config MKQNX_ZONEINFO_PATH
	string "Custom Zoneinfo Path"
	depends on MKQNX_ZONEINFO_SRC_CUSTOM

config MKQNX_TZ
	string "Timezone"
	default "UTC"
	help
	  The time zone the target is used in. The format is as specified by
	  the POSIX TZ format (e.g.
	  stdoffset[dst[offset][,start[/time],end[/time]]]), and accepts the
	  zoneinfo style as well (e.g. America/Montreal), though in that
	  case, the --zoneinfo option needs to be configured. To configure,
	  for example, Eastern Time, you would use
	  EST5EDT,M3.2.0/2,M11.1.0/2.
	  

endmenu # File System & Integrity
```

## hw/Kconfig
```kconfig
menu "Hardware"

config MKQNX_USB
	bool "Enable USB support"
	default y
    help
        If yes, enable USB.

config MKQNX_GRAPHICS
	bool "Include graphics libs and start screen"
	default n
    help
        Include graphics related libraries and binaries.  This will also start screen on boot.
        
config MKQNX_NFS
	string "NFS mount spec (<host>:<export> or 'no')"
	default "no"
    help
        To have a directory exported by a host mounted on a target specify the host
        name or IP address and the exported directory in the form "<host>:<export>".
        This will be mounted at /fs/qnx.

endmenu # Hardware
```

## net/Kconfig
```kconfig
menu "Networking"

config MKQNX_IP
	string "Static IP address or 'dhcp'"
	default "dhcp"
	help
	  Static IP address to use or dhcp to obtain an address using DHCP.


config MKQNX_HOSTNAME
	string "System hostname"
	default ""
	help
	  Hostname for system.

config MKQNX_MACADDR
	string "MAC address (xx:xx:xx:xx:xx:xx)"
	default ""
	help
	  The MAC address for the network interface. You do not usually want
	  to set this option in which case it is set to a randomly chosen
	  value.

config MKQNX_TIME_SERVERS
	string "NTP servers, colon-separated"
	default "pool.ntp.org"
	help
	  Colon-separated list of NTP servers to set time by on boot. This
	  applies only for targets that do not have access to a real-time
	  clock.
	  
	  The default is pool.ntp.org. This may have to be changed to a
	  local server if the target is run on a network that blocks NTP
	  traffic.

endmenu # Networking
```

## part/Kconfig
```kconfig
menu "Partitioning"

config MKQNX_PART_SIZES
	string "Partition sizing mode"
	default "full"
	help
	  If set to full, partitions are sized based on contents and
	  --sys-size and --data-size options. Alternatively, fixed sizes can
	  be specified for the boot, system and data partitions (in MB). This
	  permits individual partitions to be updated selectively (see --copy
	  and --update options). This is primarily useful when the data will
	  be written to some external media such as SD cards for booting a
	  real target. When the image will be written to an SD card, the data
	  size can be omitted in which case the data partition will be made to
	  fill the available space.

config MKQNX_BOOT_SIZE
	int "Extra boot size in MB"
	default 0
	help
	  Extra space expressed in Mbytes to allocate for boot partition
	  beyond initial requirements.

config MKQNX_SYS_SIZE
	int "Extra system size in MB"
	default 0
	help
	  Extra space expressed in Mbytes to allocate for system partition
	  beyond initial requirements.

config MKQNX_DATA_SIZE
	int "Extra data size in MB"
	default 0
	help
	  Extra space expressed in Mbytes to allocate for data partition
	  beyond initial requirements.

config MKQNX_SYS_INODES
	int "Number of inodes for system partition"
	default 0
	help
	  Number of inodes in system partition


config MKQNX_DATA_INODES
	int "Number of inodes for data partition"
	default 0
	help
	  Number of inodes in data partition

endmenu # Partitioning
```

## pkg/Kconfig
```kconfig
menu "Packages"

config MKQNX_TOMCRYPT
	bool "Include Tomcrypt library"
	default n
	help
	  If yes, include Tomcrypt library. 

config MKQNX_PERL
	bool "Include Perl"
	default n
	help
	  If yes, perl is included.
	  
	  

config MKQNX_PKCS11
	bool "Include PKCS#11 support"
	default n
    help 
       If yes, the system will have PKCS#11 support installed

       


config MKQNX_PYTHON
	bool "Include Python"
	default n
    help
        If yes, python is included.

        

config MKQNX_QAUDIT
	bool "Include QAudit framework"
	default n
    help
        If yes, the qaudit framework is included in the image.

        

config MKQNX_VALGRIND
	bool "Include Valgrind"
	default n
    help
        If yes, valgrind will be part of the image and the chosen binaries will have their symbols
        stored in /data/valgrind. To execute with valgrind, run the command as:
        "valgrind <binary> ..."

        Edit the local/valgrind.files file to add the binaries for which you
        need the symbols.

        


endmenu # Packages
```

## repos/Kconfig
```kconfig
menu "Repos & Extras"

config MKQNX_REPOS
	string "Package repository paths (colon-separated)"
	default ""
	help
	  A colon separated list of directories to be used by mkifs and
	  mkqnx6fsimg to search for files. This option may contain
	  environment variables such as $QNX_TARGET. These are expanded at
	  build time. Defaults to "$QNX_STAGE_nto:$QNX_TARGET".

config MKQNX_EXTRA_DIRS
	string "Extra content directories"
	default ""
	help
	  A colon separated list of extra content directories to search for
	  mkqnximage option and other files. If the directories are preceded
	  by a '+' or '-', they are added or removed from the existing set
	  of extra directories. The directories may be absolute paths,
	  relative to the directory mkqnximage is run in or relative to any
	  'extras' directory in any current content directory. If 'none',
	  only the standard mkqnximage directory and local are used.

endmenu # Repos & Extras
```

## runtime/Kconfig
```kconfig
menu "Runtime"

choice
	prompt "Target type"
	default MKQNX_TYPE_QEMU
	help
	  Build an image for a particular target type. QEMU allows for a
	  greater selection of architectures but doesn't support graphics, and
	  might not operate on all platforms. VMWare supports graphics.
	  VirtualBox is free. QVM is for a qvm guest OS.

config MKQNX_TYPE_QEMU
	bool "qemu"
config MKQNX_TYPE_VMWARE
	bool "vmware"
config MKQNX_TYPE_VBOX
	bool "vbox"
config MKQNX_TYPE_QVM
	bool "qvm"
endchoice

config MKQNX_CPU
	int "Number of CPUs"
	default 2
	help
	  Set the number of CPUs. The default is 2 CPUs and the maximum is 4.
	  An exception is when running arm or aarch64 and the QEMU version is
	  2.*, it will only use 1 CPU. If your QEMU version is 3+, running
	  aarch64 with multiple CPUs may require a newer version of QEMU for it
	  to work.

config MKQNX_PROC
	string "Procnto executable name"
	default ""
	help
	  Set the name of the procnto executable to use. If not set then the
	  name is either procnto-smp-instr for the standard build or
	  procnto-smp-instr-safety for the safety build.

config MKQNX_RAM
	string "Amount of RAM to allocate (e.g. 512M, 1G)"
	default "1G"
	help
	  Set the amount of RAM dedicated to the image when running through
	  QEMU where <X> is the amount. M is megabytes and G is gigabytes.
	  default: 1G

endmenu # Runtime
```

## security/Kconfig
```kconfig
menu "Security & TPM"

config MKQNX_ASLR
	bool "Enable ASLR"
	default y
	help
	  If yes, use Address Space Layout Randomization. This should be
	  used on a shipping system as it improves security.
	  

config MKQNX_SECURE_PROCFS
	bool "Restrict /proc/<pid> permissions"
	default n
	help
	  If yes, permissions for /proc/<pid> will be restricted to prevent
	  access by other processes unless they have XPROCESS_QUERY or
	  XPROCESS_DEBUG abilities.

config MKQNX_CERTICOM
	bool "Include Certicom crypto libs"
	default n
	help
	  If yes, include Certicom libraries. 

choice
	prompt "TCG/TPM support"
	default MKQNX_TCG_NO
	help
	  If yes, include TCG (Trusted Computing Group) related libraries
	  and services to support the use of a TPM (Trusted Platform
	  Module). If cmdline, also include utilities to enable
	  configuration and control of the TPM from the command line.
	  
	  
config MKQNX_TCG_NO
	bool "no"
config MKQNX_TCG_YES
	bool "yes"
config MKQNX_TCG_CMDLINE
	bool "cmdline"
endchoice

config MKQNX_CRYPTODEV
	bool "Enable /dev/crypto device"
	default n
	help
	  If yes, the system will have a /dev/crypto enabled device
	  
	  

config MKQNX_POLICY
	string "Path to security policy file or 'none'"
	default "none"
	help
	  The path to the security policy file to compile and include at
	  /proc/boot/secpol.bin or none to not include a security policy.
	  This does not by itself cause the policy to be used, the use of
	  policies is controlled by the --secpol option. The --secpol option
	  can also be used to help generate the policy file as there is none
	  by default.

choice
	prompt "Security policy mode"
	default MKQNX_SECPOL_NO
	help
	  If no, don't use security polices. May also be 'secure' to use a
	  policy in secure mode, 'develop' to use in normal developer mode
	  or 'open' to be unrestricted by default.
	  
	  
config MKQNX_SECPOL_NO
	bool "no"
config MKQNX_SECPOL_DEVELOP
	bool "develop"
config MKQNX_SECPOL_OPEN
	bool "open"
config MKQNX_SECPOL_SECURE
	bool "secure"
endchoice

config MKQNX_QFIM
	bool "Include QFIM (Integrity Measurement)"
	default n
	help
	  If yes, include QFIM (QNX Framework for Integrity Measurement)
	  libraries, daemon and command line utility and launch the daemon
	  at startup. Option --tcg=yes or --tcg=cmdline is also required.
	  
	  

endmenu # Security & TPM
```

## sys/Kconfig
```kconfig
menu "System Flags"

config MKQNX_ROOT
	bool "Run services as root/allow root-sustained"
	default n
    help
        If no, have services drop root after start-up if they support it.  This is
        usually what you want.

config MKQNX_ABLELOCK
	bool "Allow ability locking"
	default y
    help    
        If yes, allow abilities to be locked without causing failures in procmgr_ability
        calls that reference them. If no, locked abilities will cause procmgr_ability
        calls to fail if they refer to a locked ability.

config MKQNX_SLM
	bool "Start system using slm instead of shell script"
	default n
    help    
        If yes, start system using slm instead of a shell script.        

endmenu # System Flags
```
